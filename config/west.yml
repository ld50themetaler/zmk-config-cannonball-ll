## config/west.yml
```yaml
manifest:
  remotes:
    - name: zmkfirmware
      url-base: https://github.com/zmkfirmware
    - name: badjeff
      url-base: https://github.com/badjeff
    - name: caksoylar
      url-base: https://github.com/caksoylar
    - name: prospector
      url-base: https://github.com/t-ogura
    - name: george-norton
      url-base: https://github.com/george-norton
    - name: sekigon-gonnoc
      url-base: https://github.com/sekigon-gonnoc
  projects:
    - name: zmk
      remote: zmkfirmware
      revision: v0.2.1
      import: app/west.yml
    - name: zmk-pmw3610-driver
      remote: badjeff
      # zmk-0.3 branch: main moved to Zephyr 4.1 (ZMK 0.4) and renamed its Kconfig symbols
      revision: 5c5af40de4d8cdf55dc63c4c5907af1e52da6a95
    - name: prospector-zmk-module
      remote: prospector
      revision: v2.2.3
    - name: zmk-behavior-sensor-attr-cycle
      remote: george-norton
      revision: main
    - name: zmk-feature-cdc-acm-bootloader-trigger
      remote: sekigon-gonnoc
      revision: v0.2
  self:
    path: config
```
